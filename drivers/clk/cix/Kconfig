## drivers/clk/cix/Kconfig
```kconfig
# SPDX-License-Identifier: GPL-2.0
# Common clock support for Cixtech SoC family
menu "Clock support for Cixtech"

comment "Clock options for Cixtech CPUs:"

config COMMON_CLK_CIX
	bool "Support for Cix's clock controllers"
	depends on ARCH_CIX || COMPILE_TEST
	select REGMAP_MMIO
	select RESET_CONTROLLER

if COMMON_CLK_CIX

config CIX_ACPI_CLK
        bool "CIX Clock Management API for acpi"
        depends on ARCH_CIX && ACPI
        help
          This provides the clock management API for CIX Technologies, Inc.
          Say Y if you want to support clock driver.

config CLK_SKY1_AUDSS
	tristate "Cixtech Sky1 Audio Subsystem Clock Driver"
	depends on CIX_ACPI_CLK || COMPILE_TEST
	help
	    Support for the Audio Subsystem clock controller present on
	    Cixtech Sky1 SoC. Choose M or Y here if you want to build this
	    driver.

config CIX_CLK_DEBUG
	tristate "Cix SoC Clock Debug Driver"
	help
	  Support on-line debug soc clocks from the debugfs interface.

endif # COMMON_CLK_CIX

endmenu
```

## drivers/misc/Kconfig.rej
```kconfig
--- drivers/misc/Kconfig
+++ drivers/misc/Kconfig
@@ -580,4 +580,5 @@ source "drivers/misc/uacce/Kconfig"
 source "drivers/misc/pvpanic/Kconfig"
 source "drivers/misc/mchp_pci1xxxx/Kconfig"
 source "drivers/misc/cix/sensor/core/Kconfig"
+source "drivers/misc/cix/armchina-npu/Kconfig"
 endmenu
```

## drivers/misc/cix/sensor/cix_sensorhub/Kconfig
```kconfig
config CIX_KERNEL_SENSORHUB
	tristate "CIX SensorHub support"
	depends on CIX_SENSORHUB
	help
	  Platform driver for the CIX sensorhub hardware.
	  Interfaces with the CIX sensorhub core framework.
```

## drivers/misc/cix/sensor/core/Kconfig
```kconfig
config CIX_SENSORHUB
	tristate "CIX sensorhub core framework"
	help
	  Core framework for the CIX sensorhub architecture.
	  Provides common sensor management and communication layers
	  used by the CIX sensorhub driver.
```

## drivers/soc/cix/Kconfig
```kconfig
# SPDX-License-Identifier: GPL-2.0-only
menu "Cix Dst drivers"

config SOC_CIX
	bool "Cix Sky SoC family support"
	default n
	help
	  If you say yes here you get support for the Cix sky family
	  support, it will provide the SoC info like SoC family,
	  ID and revision etc.

config CIX_CPU_INSTPIPE_FRESH
	bool
	help
	  Legacy symbol kept for compatibility with vendor patches,
	  selected automatically by CIX_SCHED_CLOCK_ISB_WORKAROUND.

	  Original help text:

	    Say yes will fresh instpipe in sched_clock.

config CIX_SCHED_CLOCK_ISB_WORKAROUND
	bool "Insert ISB before returning from sched_clock() (was CIX_CPU_INSTPIPE_FRESH)"
	depends on ARCH_CIX
	select CIX_CPU_INSTPIPE_FRESH
	default n
	help
	  Some CPU implementations may return stale values from the cycle
	  counter if the instruction pipeline is not synchronized before
	  the read.  Enabling this option inserts an instruction
	  synchronization barrier (ISB) before returning from sched_clock(),
	  ensuring that the value is freshly read from hardware.

	  This may slightly increase overhead in timing functions and should
	  only be enabled if required by the platform vendor or when time
	  stamps appear inconsistent.

	  If unsure, say N.


config CIX_SKY1_SOCINFO
	bool "Cix Sky1 SoC Information driver"
	depends on ARCH_CIX
	select SOC_BUS
	help
	  Say yes to support decoding of CIX Sky1 SoC family information
	  about the type and version.

config CIX_SE_CONFIG
	bool "Cix Sky1 AP config SE interface"
	depends on ARCH_CIX
	help
	  Say yes to support AP config SE settings by AP2SE mailbox

config CIX_SOC_ACPI
	bool "Cix SoC ACPI drivers"
	depends on ARCH_CIX && ACPI
	select SOC_BUS
	help
	  Say yes to support CIX SoC ACPI drivers.

config CIX_AP2SE_IPC
	bool "Cix AP2SE IPC drivers"
	depends on ARCH_CIX
	select CIX_MBOX
	help
	  Say yes to support Cix SE2AP IPC drivers.

if SOC_CIX
source "drivers/soc/cix/cix_dst/Kconfig"
endif #SOC_CIX

menu "Cix Performance"
source "drivers/soc/cix/sched/Kconfig"
endmenu # Cix Performance

endmenu
```

## drivers/staging/hievent/Kconfig
```kconfig
# SPDX-License-Identifier: GPL-2.0
config HIEVENT
	tristate "Enable HiSysEvent HiEvent subsystem"
	depends on ARCH_CIX_EMU_FPGA && EXPERIMENTAL
	help
	  Enable the Android OpenHarmony HiEvent event-logging subsystem

config BBOX_BUFFER_SIZE
	int "bbox buffer size"
	depends on HIEVENT
	default 2048
	help
	  Define the default ring buffer size of BBOX
```

## drivers/staging/hisysevent/Kconfig
```kconfig
# SPDX-License-Identifier: GPL-2.0
config HISYSEVENT
	bool "Enable HiSysEvent framework"
	depends on HIEVENT && EXPERIMENTAL
	default y if PLAT_BBOX
	help
	  Say Y here to enable the Android OpenHarmony HiSysEvent framework.
```

## drivers/staging/hungtask/Kconfig
```kconfig
# SPDX-License-Identifier: GPL-2.0
config DFX_HUNGTASK
	bool "DFX hungtask"
	depends on ARCH_CIX_FPGA && DETECT_HUNG_TASK && EXPERIMENTAL
	default n
	help
	  Base DFX hungtask module

config DFX_HUNGTASK_USER
	bool "DFX hungtask user watchdog module"
	depends on DFX_HUNGTASK
	default n
	help
	  DFX hungtask user watchdog module
```
